## CMakeLists.txt
```
cmake_minimum_required(VERSION 3.20.0)

find_package(Zephyr REQUIRED HINTS $ENV{ZEPHYR_BASE})
project(peripheral)

set(BENCH_MLKEM_BACKEND "$ENV{BENCH_MLKEM_BACKEND}" CACHE STRING "ML-KEM implementation")
if(BENCH_MLKEM_BACKEND STREQUAL "")
    set(BENCH_MLKEM_BACKEND "pqm4-m4fstack")
endif()
option(BENCH_POWER_MARKERS "Enable PPK2 GPIO timing markers" OFF)
option(BENCH_BLE_TELEMETRY "Send structured benchmark output over BLE L2CAP" OFF)
option(BENCH_MTLS_MODE "Load the fixed client identity for mutual TLS" OFF)
option(BENCH_TRANSFER_MODE "Run bidirectional MQTT payload transfers" OFF)
option(BENCH_L2CAP_LINUX_ZERO_IDENT_CREDITS
    "Accept Linux LE credit updates after its signaling ident pool wraps" ON)
if(DEFINED ENV{BENCH_TRANSFER_MODE})
    set(BENCH_TRANSFER_MODE "$ENV{BENCH_TRANSFER_MODE}" CACHE BOOL
        "Run bidirectional MQTT payload transfers" FORCE)
endif()
if(DEFINED ENV{BENCH_MTLS_MODE})
    set(BENCH_MTLS_MODE "$ENV{BENCH_MTLS_MODE}" CACHE BOOL
        "Load the fixed client identity for mutual TLS" FORCE)
endif()

# Some Raspberry Pi kernels leak one signaling identifier per LE credit update.
# Apply the narrow Zephyr-side interoperability fix only for transfer builds.
if(BENCH_TRANSFER_MODE AND BENCH_L2CAP_LINUX_ZERO_IDENT_CREDITS)
    set(BENCH_L2CAP_PATCH
        "${CMAKE_CURRENT_LIST_DIR}/patches/zephyr-l2cap-zero-credit-ident.patch")
    execute_process(
        COMMAND git -C "${ZEPHYR_BASE}" apply --reverse --check "${BENCH_L2CAP_PATCH}"
        RESULT_VARIABLE BENCH_L2CAP_PATCHED
        OUTPUT_QUIET ERROR_QUIET
    )
    if(NOT BENCH_L2CAP_PATCHED EQUAL 0)
        execute_process(
            COMMAND git -C "${ZEPHYR_BASE}" apply --check "${BENCH_L2CAP_PATCH}"
            RESULT_VARIABLE BENCH_L2CAP_PATCH_APPLIES
            OUTPUT_QUIET ERROR_VARIABLE BENCH_L2CAP_PATCH_ERROR
        )
        if(NOT BENCH_L2CAP_PATCH_APPLIES EQUAL 0)
            message(FATAL_ERROR
                "Cannot apply the Zephyr L2CAP credit compatibility patch: "
                "${BENCH_L2CAP_PATCH_ERROR}")
        endif()
        execute_process(
            COMMAND git -C "${ZEPHYR_BASE}" apply "${BENCH_L2CAP_PATCH}"
            COMMAND_ERROR_IS_FATAL ANY
        )
    endif()
endif()
option(BENCH_CERTIFICATE_GEN "Build the on-device certificate benchmark" OFF)
option(BENCH_KEM_OPERATIONS "Build the on-device KEM operation benchmark" OFF)
set_property(CACHE BENCH_MLKEM_BACKEND PROPERTY STRINGS wolfssl pqm4-m4fstack)

if(BENCH_CERTIFICATE_GEN AND BENCH_KEM_OPERATIONS)
    message(FATAL_ERROR "BENCH_CERTIFICATE_GEN and BENCH_KEM_OPERATIONS are mutually exclusive")
endif()

if(NOT DEFINED BENCH_GENERATED_DIR AND DEFINED ENV{BENCH_GENERATED_DIR})
    set(BENCH_GENERATED_DIR "$ENV{BENCH_GENERATED_DIR}")
endif()
if(NOT DEFINED PQM4_ROOT AND DEFINED ENV{PQM4_ROOT})
    set(PQM4_ROOT "$ENV{PQM4_ROOT}")
endif()
if(NOT BENCH_CERTIFICATE_GEN AND NOT BENCH_KEM_OPERATIONS AND
   NOT DEFINED BENCH_GENERATED_DIR)
    message(FATAL_ERROR "BENCH_GENERATED_DIR must contain benchmark_credentials.h")
endif()
if(NOT BENCH_CERTIFICATE_GEN AND NOT BENCH_KEM_OPERATIONS AND
   NOT EXISTS "${BENCH_GENERATED_DIR}/benchmark_credentials.h")
    message(FATAL_ERROR "Missing ${BENCH_GENERATED_DIR}/benchmark_credentials.h")
endif()

# SLH-DSA X.509 support landed after wolfSSL 5.9.1. Pin the reviewed upstream
# revision so pristine builds are reproducible while avoiding changes to NCS.
include(FetchContent)
if(POLICY CMP0169)
    cmake_policy(SET CMP0169 OLD)
endif()
set(FETCHCONTENT_BASE_DIR "${CMAKE_BINARY_DIR}/_deps")
FetchContent_Declare(wolfssl_upstream
    URL https://github.com/wolfSSL/wolfssl/archive/dd6da70d395a0cb26446326f329678fe3bfb212c.tar.gz
    URL_HASH SHA256=087ac84de980da83e7f1a3014dd241358f64d9a330dec74c6eb1404495ad2cf7
    DOWNLOAD_EXTRACT_TIMESTAMP FALSE
)
FetchContent_GetProperties(wolfssl_upstream)
if(NOT wolfssl_upstream_POPULATED)
    FetchContent_Populate(wolfssl_upstream)
endif()
set(WOLFSSL_ROOT_DIR "${wolfssl_upstream_SOURCE_DIR}")

# Add benchmark-only timing hooks to the disposable wolfSSL source copy.
set(WOLFSSL_ASN_C "${WOLFSSL_ROOT_DIR}/wolfcrypt/src/asn.c")
file(READ "${WOLFSSL_ASN_C}" WOLFSSL_ASN_TEXT)
string(REPLACE
    "    WOLFSSL_ENTER(\"ConfirmSignature\");"
    "    benchmark_timepoint_t benchmark_verify_start = benchmark_crypto_metric_start(BENCH_CRYPTO_CERT_VERIFY);\n    WOLFSSL_ENTER(\"ConfirmSignature\");"
    WOLFSSL_ASN_TEXT "${WOLFSSL_ASN_TEXT}"
)
string(REPLACE
    "    WOLFSSL_LEAVE(\"ConfirmSignature\", ret);"
    "    WOLFSSL_LEAVE(\"ConfirmSignature\", ret);\n    benchmark_metric_stop(BENCH_CRYPTO_CERT_VERIFY, benchmark_verify_start);"
    WOLFSSL_ASN_TEXT "${WOLFSSL_ASN_TEXT}"
)
string(REPLACE
    "#include <wolfssl/wolfcrypt/asn.h>"
    "#include <wolfssl/wolfcrypt/asn.h>\n#include \"benchmark_metrics.h\""
    WOLFSSL_ASN_TEXT "${WOLFSSL_ASN_TEXT}"
)
file(WRITE "${WOLFSSL_ASN_C}" "${WOLFSSL_ASN_TEXT}")

if(NOT BENCH_MLKEM_BACKEND STREQUAL "pqm4-m4fstack")
set(WOLFSSL_MLKEM_C "${WOLFSSL_ROOT_DIR}/wolfcrypt/src/wc_mlkem.c")
file(READ "${WOLFSSL_MLKEM_C}" WOLFSSL_MLKEM_TEXT)
string(REPLACE
    "#include <wolfssl/wolfcrypt/wc_mlkem.h>"
    "#include <wolfssl/wolfcrypt/wc_mlkem.h>\n#include \"benchmark_metrics.h\""
    WOLFSSL_MLKEM_TEXT "${WOLFSSL_MLKEM_TEXT}"
)
string(REPLACE
    "    unsigned char rand[WC_ML_KEM_MAKEKEY_RAND_SZ];"
    "    unsigned char rand[WC_ML_KEM_MAKEKEY_RAND_SZ];\n    benchmark_timepoint_t benchmark_kem_start = benchmark_crypto_metric_start(BENCH_CRYPTO_KEM_KEYGEN);"
    WOLFSSL_MLKEM_TEXT "${WOLFSSL_MLKEM_TEXT}"
)
string(REPLACE
    "    /* Step 4: return ret != 0 on falsum or internal key generation failure. */\n    return ret;"
    "    /* Step 4: return ret != 0 on falsum or internal key generation failure. */\n    benchmark_metric_stop(BENCH_CRYPTO_KEM_KEYGEN, benchmark_kem_start);\n    return ret;"
    WOLFSSL_MLKEM_TEXT "${WOLFSSL_MLKEM_TEXT}"
)
string(REPLACE
    "    unsigned char m[WC_ML_KEM_ENC_RAND_SZ];"
    "    unsigned char m[WC_ML_KEM_ENC_RAND_SZ];\n    benchmark_timepoint_t benchmark_kem_start = benchmark_crypto_metric_start(BENCH_CRYPTO_KEM_ENCAPSULATE);"
    WOLFSSL_MLKEM_TEXT "${WOLFSSL_MLKEM_TEXT}"
)
string(REPLACE
    "    /* Step 3: return ret != 0 on falsum or internal key generation failure. */\n    return ret;"
    "    /* Step 3: return ret != 0 on falsum or internal key generation failure. */\n    benchmark_metric_stop(BENCH_CRYPTO_KEM_ENCAPSULATE, benchmark_kem_start);\n    return ret;"
    WOLFSSL_MLKEM_TEXT "${WOLFSSL_MLKEM_TEXT}"
)
string(REPLACE
    "    int ret = 0;\n    unsigned int ctSz = 0;"
    "    int ret = 0;\n    benchmark_timepoint_t benchmark_kem_start = benchmark_crypto_metric_start(BENCH_CRYPTO_KEM_DECAPSULATE);\n    unsigned int ctSz = 0;"
    WOLFSSL_MLKEM_TEXT "${WOLFSSL_MLKEM_TEXT}"
)
string(REPLACE
    "    ForceZero(msg, sizeof(msg));\n    ForceZero(kr, sizeof(kr));\n\n    return ret;"
    "    ForceZero(msg, sizeof(msg));\n    ForceZero(kr, sizeof(kr));\n\n    benchmark_metric_stop(BENCH_CRYPTO_KEM_DECAPSULATE, benchmark_kem_start);\n    return ret;"
    WOLFSSL_MLKEM_TEXT "${WOLFSSL_MLKEM_TEXT}"
)
file(WRITE "${WOLFSSL_MLKEM_C}" "${WOLFSSL_MLKEM_TEXT}")
endif()

# Hybrid X25519 key shares derive their classical secret directly in tls.c,
# bypassing the X25519SharedSecret wrapper instrumented below.
set(WOLFSSL_TLS_C "${WOLFSSL_ROOT_DIR}/src/tls.c")
file(READ "${WOLFSSL_TLS_C}" WOLFSSL_TLS_TEXT)
string(REPLACE
    "#include <wolfssl/wolfcrypt/libwolfssl_sources.h>"
    "#include <wolfssl/wolfcrypt/libwolfssl_sources.h>\n#include \"benchmark_metrics.h\""
    WOLFSSL_TLS_TEXT "${WOLFSSL_TLS_TEXT}"
)
string(REPLACE
    "            ret = wc_curve25519_shared_secret_ex(key, ssl->peerX25519Key,\n                        ssOutput, ssOutSz, EC25519_LITTLE_ENDIAN);"
    "            benchmark_timepoint_t benchmark_x25519_hybrid_start =\n                benchmark_crypto_metric_start(BENCH_CRYPTO_CLASSICAL_KEX_SHARED_SECRET);\n            ret = wc_curve25519_shared_secret_ex(key, ssl->peerX25519Key,\n                        ssOutput, ssOutSz, EC25519_LITTLE_ENDIAN);\n            benchmark_metric_stop(BENCH_CRYPTO_CLASSICAL_KEX_SHARED_SECRET,\n                                  benchmark_x25519_hybrid_start);"
    WOLFSSL_TLS_TEXT "${WOLFSSL_TLS_TEXT}"
)
file(WRITE "${WOLFSSL_TLS_C}" "${WOLFSSL_TLS_TEXT}")

# Heap-integer RSA-15360 spends several seconds inside modular exponentiation.
# Add scheduler points between exponent steps so Bluetooth controller threads
# can service connection events without changing any cryptographic operation.
if(BENCH_LARGE_RSA)
    set(WOLFSSL_INTEGER_C "${WOLFSSL_ROOT_DIR}/wolfcrypt/src/integer.c")
    file(READ "${WOLFSSL_INTEGER_C}" WOLFSSL_INTEGER_TEXT)
    string(REPLACE
        "#include <wolfssl/wolfcrypt/libwolfssl_sources.h>"
        "#include <wolfssl/wolfcrypt/libwolfssl_sources.h>\n#include \"benchmark_metrics.h\""
        WOLFSSL_INTEGER_TEXT "${WOLFSSL_INTEGER_TEXT}"
    )
    string(REPLACE
        "  for (;;) {\n    /* grab next digit as required */"
        "  for (;;) {\n    benchmark_crypto_reschedule();\n    /* grab next digit as required */"
        WOLFSSL_INTEGER_TEXT "${WOLFSSL_INTEGER_TEXT}"
    )
    string(REPLACE
        "  for (x = (1 << (winsize - 1)) + 1; x < (1 << winsize); x++) {\n    if ((err = mp_mul"
        "  for (x = (1 << (winsize - 1)) + 1; x < (1 << winsize); x++) {\n    benchmark_crypto_reschedule();\n    if ((err = mp_mul"
        WOLFSSL_INTEGER_TEXT "${WOLFSSL_INTEGER_TEXT}"
    )
    string(REPLACE
        "  for (ix = 0; ix < pa; ix++) {"
        "  for (ix = 0; ix < pa; ix++) {\n    if ((ix & 31) == 0) benchmark_crypto_reschedule();"
        WOLFSSL_INTEGER_TEXT "${WOLFSSL_INTEGER_TEXT}"
    )
    string(REPLACE
        "  for (ix = 0; ix < pa && a->dp; ix++) {"
        "  for (ix = 0; ix < pa && a->dp; ix++) {\n    if ((ix & 31) == 0) benchmark_crypto_reschedule();"
        WOLFSSL_INTEGER_TEXT "${WOLFSSL_INTEGER_TEXT}"
    )
    file(WRITE "${WOLFSSL_INTEGER_C}" "${WOLFSSL_INTEGER_TEXT}")
endif()

# Instrument the classic half of ECDHE/hybrid key exchange and optional mTLS.
set(WOLFSSL_INTERNAL_C "${WOLFSSL_ROOT_DIR}/src/internal.c")
file(READ "${WOLFSSL_INTERNAL_C}" WOLFSSL_INTERNAL_TEXT)
string(REPLACE
    "#include <wolfssl/wolfcrypt/libwolfssl_sources.h>"
    "#include <wolfssl/wolfcrypt/libwolfssl_sources.h>\n#include \"benchmark_metrics.h\""
    WOLFSSL_INTERNAL_TEXT "${WOLFSSL_INTERNAL_TEXT}"
)
foreach(PAIR IN ITEMS
    "EccSharedSecret|BENCH_CRYPTO_CLASSICAL_KEX_SHARED_SECRET"
    "EccMakeKey|BENCH_CRYPTO_CLASSICAL_KEX_KEYGEN"
    "X25519SharedSecret|BENCH_CRYPTO_CLASSICAL_KEX_SHARED_SECRET"
    "X25519MakeKey|BENCH_CRYPTO_CLASSICAL_KEX_KEYGEN"
    "EccSign|BENCH_CRYPTO_MTLS_SIGN"
)
    string(REPLACE "|" ";" PAIR_PARTS "${PAIR}")
    list(GET PAIR_PARTS 0 FUNCTION_NAME)
    list(GET PAIR_PARTS 1 METRIC_NAME)
    string(REPLACE
        "    WOLFSSL_ENTER(\"${FUNCTION_NAME}\");"
        "    benchmark_timepoint_t benchmark_${FUNCTION_NAME}_start = benchmark_crypto_metric_start(${METRIC_NAME});\n    WOLFSSL_ENTER(\"${FUNCTION_NAME}\");"
        WOLFSSL_INTERNAL_TEXT "${WOLFSSL_INTERNAL_TEXT}"
    )
    string(REPLACE
        "    WOLFSSL_LEAVE(\"${FUNCTION_NAME}\", ret);"
        "    benchmark_metric_stop(${METRIC_NAME}, benchmark_${FUNCTION_NAME}_start);\n    WOLFSSL_LEAVE(\"${FUNCTION_NAME}\", ret);"
        WOLFSSL_INTERNAL_TEXT "${WOLFSSL_INTERNAL_TEXT}"
    )
endforeach()
file(WRITE "${WOLFSSL_INTERNAL_C}" "${WOLFSSL_INTERNAL_TEXT}")

if(BENCH_MTLS_MODE)
    target_compile_definitions(app PRIVATE BENCH_MTLS_MODE=1)
else()
    target_compile_definitions(app PRIVATE BENCH_MTLS_MODE=0)
endif()
if(BENCH_TRANSFER_MODE)
    target_compile_definitions(app PRIVATE BENCH_TRANSFER_MODE=1)
endif()

# Measure processing of the server's TLS 1.3 CertificateVerify separately
# from X.509 chain signature verification.
set(WOLFSSL_TLS13_C "${WOLFSSL_ROOT_DIR}/src/tls13.c")
file(READ "${WOLFSSL_TLS13_C}" WOLFSSL_TLS13_TEXT)
string(REPLACE
    "#include <wolfssl/wolfcrypt/libwolfssl_sources.h>"
    "#include <wolfssl/wolfcrypt/libwolfssl_sources.h>\n#include \"benchmark_metrics.h\""
    WOLFSSL_TLS13_TEXT "${WOLFSSL_TLS13_TEXT}"
)
string(REPLACE
    "static int DoTls13CertificateVerify(WOLFSSL* ssl, byte* input,\n                                    word32* inOutIdx, word32 totalSz)\n{\n    int         ret = 0;"
    "static int DoTls13CertificateVerify(WOLFSSL* ssl, byte* input,\n                                    word32* inOutIdx, word32 totalSz)\n{\n    benchmark_timepoint_t benchmark_tls_cert_verify_start = benchmark_crypto_metric_start(BENCH_CRYPTO_TLS_CERT_VERIFY);\n    int         ret = 0;"
    WOLFSSL_TLS13_TEXT "${WOLFSSL_TLS13_TEXT}"
)
string(REPLACE
    "exit_dcv:\n\n    WOLFSSL_LEAVE(\"DoTls13CertificateVerify\", ret);"
    "exit_dcv:\n\n    benchmark_metric_stop(BENCH_CRYPTO_TLS_CERT_VERIFY, benchmark_tls_cert_verify_start);\n    WOLFSSL_LEAVE(\"DoTls13CertificateVerify\", ret);"
    WOLFSSL_TLS13_TEXT "${WOLFSSL_TLS13_TEXT}"
)
string(REPLACE
    "                ret = DecodeTls13SigAlg(input + args->idx,"
    "                benchmark_record_server_certificate_verify_scheme(\n                    ((word16)input[args->idx] << 8) | input[args->idx + 1]);\n                ret = DecodeTls13SigAlg(input + args->idx,"
    WOLFSSL_TLS13_TEXT "${WOLFSSL_TLS13_TEXT}"
)
file(WRITE "${WOLFSSL_TLS13_C}" "${WOLFSSL_TLS13_TEXT}")

# This pinned wolfSSL revision sizes two classic RSA ASN/TLS buffers for
# RSA-4096 by default. Patch only the disposable FetchContent copy so the
# fast-math image can parse and encode RSA-PSS-15360 material.
set(WOLFSSL_TYPES_H "${WOLFSSL_ROOT_DIR}/wolfssl/wolfcrypt/types.h")
file(READ "${WOLFSSL_TYPES_H}" WOLFSSL_TYPES_TEXT)
string(REPLACE
    "MAX_ENCODED_CLASSIC_SIG_SZ = 512,     /* Supports 4096 bit keys */"
    "MAX_ENCODED_CLASSIC_SIG_SZ = RSA_MAX_SIZE / 8,"
    WOLFSSL_TYPES_TEXT "${WOLFSSL_TYPES_TEXT}"
)
string(REPLACE
    "MAX_RSA_INT_SZ      = (512 + 1 + MAX_LENGTH_SZ), /* RSA raw sz 4096 for bits + tag + len(5) */"
    "MAX_RSA_INT_SZ      = (RSA_MAX_SIZE / 8 + 1 + MAX_LENGTH_SZ),"
    WOLFSSL_TYPES_TEXT "${WOLFSSL_TYPES_TEXT}"
)
file(WRITE "${WOLFSSL_TYPES_H}" "${WOLFSSL_TYPES_TEXT}")

set(WOLFSSL_INTERNAL_H "${WOLFSSL_ROOT_DIR}/wolfssl/internal.h")
file(READ "${WOLFSSL_INTERNAL_H}" WOLFSSL_INTERNAL_TEXT)
string(REPLACE
    "#define ENCRYPT_BASE_BITS  8192"
    "#define ENCRYPT_BASE_BITS  (FP_MAX_BITS / 2)"
    WOLFSSL_INTERNAL_TEXT "${WOLFSSL_INTERNAL_TEXT}"
)
file(WRITE "${WOLFSSL_INTERNAL_H}" "${WOLFSSL_INTERNAL_TEXT}")

# 1. Bind EVERYTHING directly to the 'app' target
if(BENCH_CERTIFICATE_GEN)
    target_sources(app PRIVATE
        src/certgen_main.c src/benchmark_metrics.c src/power_markers.c)
elseif(BENCH_KEM_OPERATIONS)
    target_sources(app PRIVATE
        src/kem_bench_main.c src/benchmark_metrics.c src/power_markers.c)
else()
    target_sources(app PRIVATE src/main.c src/benchmark_metrics.c src/power_markers.c)
    if(BENCH_TRANSFER_MODE)
        target_sources(app PRIVATE src/mqtt_transfer.c)
    endif()
endif()

target_sources(app PRIVATE
    # --- Post Quantum Math ---
    ${WOLFSSL_ROOT_DIR}/wolfcrypt/src/wc_mlkem.c
    ${WOLFSSL_ROOT_DIR}/wolfcrypt/src/wc_mlkem_poly.c
    ${WOLFSSL_ROOT_DIR}/wolfcrypt/src/wc_mldsa.c
    ${WOLFSSL_ROOT_DIR}/wolfcrypt/src/wc_slhdsa.c
    ${WOLFSSL_ROOT_DIR}/wolfcrypt/src/wc_lms.c
    ${WOLFSSL_ROOT_DIR}/wolfcrypt/src/wc_lms_impl.c
    ${WOLFSSL_ROOT_DIR}/wolfcrypt/src/wc_xmss.c
    ${WOLFSSL_ROOT_DIR}/wolfcrypt/src/wc_xmss_impl.c
    
    # --- Core Cryptography & Hashes ---
    ${WOLFSSL_ROOT_DIR}/wolfcrypt/src/random.c
    ${WOLFSSL_ROOT_DIR}/wolfcrypt/src/hash.c
    ${WOLFSSL_ROOT_DIR}/wolfcrypt/src/sha.c
    ${WOLFSSL_ROOT_DIR}/wolfcrypt/src/sha256.c
    ${WOLFSSL_ROOT_DIR}/wolfcrypt/src/sha512.c
    ${WOLFSSL_ROOT_DIR}/wolfcrypt/src/sha3.c
    ${WOLFSSL_ROOT_DIR}/wolfcrypt/src/hmac.c
    ${WOLFSSL_ROOT_DIR}/wolfcrypt/src/aes.c
    ${WOLFSSL_ROOT_DIR}/wolfcrypt/src/ecc.c
    # Keep ECC on wolfSSL's Cortex-M SP backend. TFM remains available below
    # with FP_MAX_BITS=32768 for the intentionally oversized RSA cases.
    ${WOLFSSL_ROOT_DIR}/wolfcrypt/src/sp_cortexm.c
    ${WOLFSSL_ROOT_DIR}/wolfcrypt/src/curve25519.c
    ${WOLFSSL_ROOT_DIR}/wolfcrypt/src/rsa.c
    ${WOLFSSL_ROOT_DIR}/wolfcrypt/src/kdf.c
    ${WOLFSSL_ROOT_DIR}/wolfcrypt/src/ed25519.c
    
    # --- Legacy Support ---
    ${WOLFSSL_ROOT_DIR}/wolfcrypt/src/md5.c
    ${WOLFSSL_ROOT_DIR}/wolfcrypt/src/des3.c
    ${WOLFSSL_ROOT_DIR}/wolfcrypt/src/dh.c
    ${WOLFSSL_ROOT_DIR}/wolfcrypt/src/dsa.c

    # --- Math Helpers & Decoding ---
    ${WOLFSSL_ROOT_DIR}/wolfcrypt/src/coding.c
    ${WOLFSSL_ROOT_DIR}/wolfcrypt/src/misc.c
    ${WOLFSSL_ROOT_DIR}/wolfcrypt/src/wolfmath.c
    ${WOLFSSL_ROOT_DIR}/wolfcrypt/src/fe_operations.c
    ${WOLFSSL_ROOT_DIR}/wolfcrypt/src/ge_operations.c
    
    # --- Memory & System ---
    ${WOLFSSL_ROOT_DIR}/wolfcrypt/src/tfm.c
    ${WOLFSSL_ROOT_DIR}/wolfcrypt/src/integer.c
    ${WOLFSSL_ROOT_DIR}/wolfcrypt/src/memory.c
    ${WOLFSSL_ROOT_DIR}/wolfcrypt/src/asn.c
    ${WOLFSSL_ROOT_DIR}/wolfcrypt/src/wc_port.c
    ${WOLFSSL_ROOT_DIR}/wolfcrypt/src/logging.c
    
    # --- TLS Engine ---
    ${WOLFSSL_ROOT_DIR}/src/ssl.c
    ${WOLFSSL_ROOT_DIR}/src/tls.c
    ${WOLFSSL_ROOT_DIR}/src/tls13.c
    ${WOLFSSL_ROOT_DIR}/src/keys.c
    ${WOLFSSL_ROOT_DIR}/src/internal.c
    ${WOLFSSL_ROOT_DIR}/src/wolfio.c
)

if(BENCH_POWER_MARKERS)
    target_compile_definitions(app PRIVATE BENCH_POWER_MARKERS=1)
endif()
if(BENCH_BLE_TELEMETRY)
    target_compile_definitions(app PRIVATE BENCH_BLE_TELEMETRY=1)
endif()
if(BENCH_CERTIFICATE_GEN)
    target_compile_definitions(app PRIVATE BENCH_CERTIFICATE_GEN=1)
endif()
if(BENCH_KEM_OPERATIONS)
    target_compile_definitions(app PRIVATE BENCH_KEM_OPERATIONS=1)
endif()

target_include_directories(app PRIVATE 
    ${CMAKE_CURRENT_SOURCE_DIR}
    ${CMAKE_CURRENT_SOURCE_DIR}/src
    ${BENCH_GENERATED_DIR}
    ${WOLFSSL_ROOT_DIR}
    ${WOLFSSL_ROOT_DIR}/wolfssl
)

# CRITICAL FIX: Target-specific definitions and includes (NOT Global)
target_compile_definitions(app PRIVATE
    WOLFSSL_USER_SETTINGS
    FP_MAX_BITS=32768
    BENCHMARK_CLOSE_AFTER_TLS=0
)
target_compile_options(app PRIVATE -include ${CMAKE_CURRENT_SOURCE_DIR}/user_settings.h)

target_compile_definitions(app PRIVATE
    BENCH_RSA_PROFILE_NAME="fast-math"
)

if(BENCH_MLKEM_BACKEND STREQUAL "pqm4-m4fstack" AND NOT BENCH_CERTIFICATE_GEN)
    if(NOT DEFINED PQM4_ROOT OR
       NOT EXISTS "${PQM4_ROOT}/crypto_kem/ml-kem-512/m4fstack/kem.c")
        message(FATAL_ERROR "PQM4_ROOT must point to a complete pqm4 checkout")
    endif()

    set(PQM4_COMMON "${PQM4_ROOT}/mupq/common")
    add_library(pqm4_fips202 OBJECT
        "${PQM4_COMMON}/fips202.c"
        "${PQM4_ROOT}/common/keccakf1600.S"
        src/pqm4_randombytes.c
    )
    target_include_directories(pqm4_fips202 PRIVATE "${PQM4_COMMON}")
    target_link_libraries(pqm4_fips202 PRIVATE zephyr_interface)

    function(add_pqm4_mlkem target level)
        set(src "${PQM4_ROOT}/crypto_kem/ml-kem-${level}/m4fstack")
        add_library(${target} OBJECT
            "${src}/cbd.c"
            "${src}/cmov_int16.S"
            "${src}/fastaddsub.S"
            "${src}/fastbasemul.S"
            "${src}/fastinvntt.S"
            "${src}/fastntt.S"
            "${src}/indcpa.c"
            "${src}/kem.c"
            "${src}/matacc.c"
            "${src}/matacc_asm.S"
            "${src}/ntt.c"
            "${src}/poly.c"
            "${src}/poly_asm.S"
            "${src}/polyvec.c"
            "${src}/reduce.S"
            "${src}/symmetric-fips202.c"
            "${src}/verify.c"
        )
        target_include_directories(${target} PRIVATE
            "${src}" "${PQM4_COMMON}" "${CMAKE_CURRENT_SOURCE_DIR}/src"
        )
        target_compile_definitions(${target} PRIVATE
            PQM4_PREFIX=pqm4_mlkem${level}_
            asm=__asm__
        )
        target_compile_options(${target} PRIVATE
            -include ${CMAKE_CURRENT_SOURCE_DIR}/src/pqm4_namespace.h
            $<$<COMPILE_LANGUAGE:C>:-std=gnu17>
        )
        target_link_libraries(${target} PRIVATE zephyr_interface)
    endfunction()

    add_pqm4_mlkem(pqm4_mlkem512 512)
    add_pqm4_mlkem(pqm4_mlkem768 768)
    add_pqm4_mlkem(pqm4_mlkem1024 1024)
    target_sources(app PRIVATE
        src/pqm4_mlkem_backend.c
        ${WOLFSSL_ROOT_DIR}/wolfcrypt/src/cryptocb.c
        $<TARGET_OBJECTS:pqm4_fips202>
        $<TARGET_OBJECTS:pqm4_mlkem512>
        $<TARGET_OBJECTS:pqm4_mlkem768>
        $<TARGET_OBJECTS:pqm4_mlkem1024>
    )
    target_compile_definitions(app PRIVATE
        BENCH_USE_PQM4_MLKEM
        BENCH_MLKEM_BACKEND_NAME="pqm4-m4fstack"
    )
else()
    target_compile_definitions(app PRIVATE
        BENCH_MLKEM_BACKEND_NAME="wolfssl"
    )
endif()
```

## Kconfig.sysbuild
```
config PARTITION_MANAGER
	default n

config NRF_DEFAULT_BLUETOOTH
	default y

source "share/sysbuild/Kconfig"
```

## prj.conf
```kconfig
# --- Basic Bluetooth ---
CONFIG_BT=y
CONFIG_BT_PERIPHERAL=y
CONFIG_BT_DEVICE_NAME="PQC52840"

# --- L2CAP ---
CONFIG_BT_L2CAP_DYNAMIC_CHANNEL=y

# --- Settings (Required for L2CAP Server) ---
CONFIG_SETTINGS=y
CONFIG_BT_SETTINGS=y
CONFIG_BT_PERIPHERAL_PREF_MIN_INT=16
CONFIG_BT_PERIPHERAL_PREF_MAX_INT=16
CONFIG_BT_PERIPHERAL_PREF_LATENCY=0
CONFIG_BT_PERIPHERAL_PREF_TIMEOUT=3200
CONFIG_NVS=y
CONFIG_FLASH=y
CONFIG_FLASH_MAP=y

CONFIG_BT_SMP=y
# CONFIG_BT_FIXED_PASSKEY is not set

# The Pi bridge disables onboard Wi-Fi during BLE runs, which removes the
# coexistence problem that made the link unstable.  Keep the BLE link fast.
CONFIG_BT_AUTO_DATA_LEN_UPDATE=y
CONFIG_BT_DATA_LEN_UPDATE=y
CONFIG_BT_PHY_UPDATE=y

# --- Hardware RNG (Required for wolfSSL PQC) ---
CONFIG_ENTROPY_GENERATOR=y
CONFIG_TEST_RANDOM_GENERATOR=y

# --- Memory & System ---
CONFIG_HEAP_MEM_POOL_SIZE=0
CONFIG_COMMON_LIBC_MALLOC_ARENA_SIZE=12288
CONFIG_MAIN_STACK_SIZE=8192
# Bluetooth RX/TX threads use priorities 6-10. Keep the CPU-heavy TLS client
# below them so long RSA/SLH operations cannot starve controller servicing.
CONFIG_MAIN_THREAD_PRIORITY=12
CONFIG_SYSTEM_WORKQUEUE_STACK_SIZE=3072
CONFIG_REBOOT=y
CONFIG_SYS_HEAP_RUNTIME_STATS=y
CONFIG_RING_BUFFER_LARGE=y

# --- Runtime benchmark telemetry ---
# Thread Analyzer gives per-thread stack usage and runtime CPU utilization on
# demand.  The benchmark calls it once after each TLS handshake so the serial
# log has a clean snapshot without a periodic analyzer thread adding noise.
CONFIG_THREAD_ANALYZER=y
CONFIG_THREAD_ANALYZER_USE_PRINTK=y
CONFIG_THREAD_NAME=y
# Keep Bluetooth interrupts unlocked while the analyzer walks thread stacks.
CONFIG_THREAD_ANALYZER_RUN_UNLOCKED=y
CONFIG_THREAD_RUNTIME_STATS=y
CONFIG_SCHED_THREAD_USAGE=y

# --- Bluetooth Buffers ---
CONFIG_BT_BUF_ACL_TX_SIZE=251
CONFIG_BT_BUF_ACL_RX_SIZE=251
CONFIG_BT_BUF_ACL_TX_COUNT=2
CONFIG_BT_BUF_EVT_RX_COUNT=6
CONFIG_BT_L2CAP_TX_MTU=672

# --- Required Dependencies ---
CONFIG_GPIO=y
CONFIG_PSA_WANT_ALG_SHA_1=y

CONFIG_FPU=y
```

## certgen.conf
```kconfig
CONFIG_BT=n
CONFIG_BT_SETTINGS=n
CONFIG_SETTINGS=n
CONFIG_NVS=n
CONFIG_CONSOLE_SUBSYS=y
CONFIG_CONSOLE_GETLINE=y
CONFIG_MAIN_STACK_SIZE=24576
CONFIG_SYSTEM_WORKQUEUE_STACK_SIZE=2048
CONFIG_THREAD_RUNTIME_STATS=y
CONFIG_THREAD_RUNTIME_STATS_USE_TIMING_FUNCTIONS=y
CONFIG_SCHED_THREAD_USAGE=y
CONFIG_SCHED_THREAD_USAGE_ALL=y
CONFIG_THREAD_NAME=y
CONFIG_INIT_STACKS=y
CONFIG_THREAD_STACK_INFO=y
```

## kem_bench.conf
```kconfig
CONFIG_BT=n
CONFIG_BT_SETTINGS=n
CONFIG_SETTINGS=n
CONFIG_NVS=n
CONFIG_CONSOLE_SUBSYS=y
CONFIG_CONSOLE_GETLINE=y
CONFIG_MAIN_STACK_SIZE=24576
CONFIG_SYSTEM_WORKQUEUE_STACK_SIZE=2048
```

## power.conf
```kconfig
# Source Meter builds have no nRF52840 USB connection. Structured benchmark
# output is carried by BCTL1 frames over BLE L2CAP, so serial/printk support
# would only consume RAM and flash.
CONFIG_CONSOLE=n
CONFIG_UART_CONSOLE=n
CONFIG_SERIAL=n
CONFIG_PRINTK=n
CONFIG_THREAD_ANALYZER_USE_PRINTK=n
```

## boards/nrf52840dk_nrf52840.conf
```kconfig
CONFIG_BT_LL_SOFTDEVICE=y
CONFIG_BT_CTLR_TX_PWR_PLUS_8=y

# wolfSSL uses its dedicated k_heap, so no separate libc arena is needed on
# the RAM-constrained nRF52840.
CONFIG_COMMON_LIBC_MALLOC_ARENA_SIZE=0
CONFIG_MAIN_STACK_SIZE=6144
CONFIG_SYSTEM_WORKQUEUE_STACK_SIZE=2048
CONFIG_BT_BUF_EVT_RX_COUNT=3
```

## boards/nrf5340dk_nrf5340_cpuapp.conf
```kconfig
# Bluetooth runs on the network core through Zephyr's sysbuild hci_ipc image.
CONFIG_BT_HCI_IPC_ENDPOINT_BOUND_TIMEOUT_MS=10000
```

## boards/nrf52840dk_nrf52840.overlay
```dts
/ {
	chosen {
		zephyr,bt-hci = &bt_hci_sdc;
	};
};

&bt_hci_controller {
	status = "disabled";
};

&bt_hci_sdc {
	status = "okay";
};
```

## src/benchmark_dwt.h
```c
#ifndef BENCHMARK_DWT_H
#define BENCHMARK_DWT_H

#include <cmsis_core.h>
#include <zephyr/types.h>

struct benchmark_dwt_snapshot {
    uint32_t cyccnt;
    uint8_t cpicnt;
    uint8_t exccnt;
    uint8_t sleepcnt;
    uint8_t lsucnt;
    uint8_t foldcnt;
    bool cycle_supported;
    bool event_supported;
};

struct benchmark_dwt_delta {
    uint32_t cyccnt;
    uint8_t cpicnt;
    uint8_t exccnt;
    uint8_t sleepcnt;
    uint8_t lsucnt;
    uint8_t foldcnt;
    bool cycle_supported;
    bool event_supported;
};

/*
 * Capture the current ARM DWT cycle and event counters.
 */
static inline struct benchmark_dwt_snapshot benchmark_dwt_snapshot_get(void)
{
    struct benchmark_dwt_snapshot snapshot = {0};

    CoreDebug->DEMCR |= CoreDebug_DEMCR_TRCENA_Msk;
    snapshot.cycle_supported =
        (DWT->CTRL & DWT_CTRL_NOCYCCNT_Msk) == 0U;
    snapshot.event_supported =
        (DWT->CTRL & DWT_CTRL_NOPRFCNT_Msk) == 0U;
    if (snapshot.cycle_supported) {
        DWT->CTRL |= DWT_CTRL_CYCCNTENA_Msk;
    }
    if (snapshot.event_supported) {
        DWT->CTRL |= DWT_CTRL_CPIEVTENA_Msk |
                     DWT_CTRL_EXCEVTENA_Msk |
                     DWT_CTRL_SLEEPEVTENA_Msk |
                     DWT_CTRL_LSUEVTENA_Msk |
                     DWT_CTRL_FOLDEVTENA_Msk;
    }
    __DSB();
    __ISB();

    if (snapshot.cycle_supported) {
        snapshot.cyccnt = DWT->CYCCNT;
    }
    if (snapshot.event_supported) {
        snapshot.cpicnt = (uint8_t)DWT->CPICNT;
        snapshot.exccnt = (uint8_t)DWT->EXCCNT;
        snapshot.sleepcnt = (uint8_t)DWT->SLEEPCNT;
        snapshot.lsucnt = (uint8_t)DWT->LSUCNT;
        snapshot.foldcnt = (uint8_t)DWT->FOLDCNT;
    }
    return snapshot;
}

/*
 * Compute modulo-safe DWT counter deltas from a prior snapshot.
 */
static inline struct benchmark_dwt_delta benchmark_dwt_delta_get(
    const struct benchmark_dwt_snapshot *start)
{
    struct benchmark_dwt_snapshot end = benchmark_dwt_snapshot_get();
    struct benchmark_dwt_delta delta = {
        .cycle_supported = start->cycle_supported && end.cycle_supported,
        .event_supported = start->event_supported && end.event_supported,
    };

    if (delta.cycle_supported) {
        delta.cyccnt = end.cyccnt - start->cyccnt;
    }
    if (delta.event_supported) {
        delta.cpicnt = (uint8_t)(end.cpicnt - start->cpicnt);
        delta.exccnt = (uint8_t)(end.exccnt - start->exccnt);
        delta.sleepcnt = (uint8_t)(end.sleepcnt - start->sleepcnt);
        delta.lsucnt = (uint8_t)(end.lsucnt - start->lsucnt);
        delta.foldcnt = (uint8_t)(end.foldcnt - start->foldcnt);
    }
    return delta;
}

#define BENCHMARK_DWT_FORMAT \
    "dwt_cycle_counter_supported=%u dwt_event_counters_supported=%u " \
    "dwt_cyccnt=%u dwt_cpicnt=%u dwt_exccnt=%u dwt_sleepcnt=%u " \
    "dwt_lsucnt=%u dwt_foldcnt=%u dwt_cycle_counter_width_bits=32 " \
    "dwt_event_counter_width_bits=8 dwt_counts_are_modulo=1"

#define BENCHMARK_DWT_VALUES(delta) \
    (unsigned int)(delta).cycle_supported, \
    (unsigned int)(delta).event_supported, \
    (unsigned int)(delta).cyccnt, \
    (unsigned int)(delta).cpicnt, \
    (unsigned int)(delta).exccnt, \
    (unsigned int)(delta).sleepcnt, \
    (unsigned int)(delta).lsucnt, \
    (unsigned int)(delta).foldcnt

#endif
```

## src/benchmark_metrics.c
```c
#include "benchmark_metrics.h"

#include <zephyr/kernel.h>
#include <hal/nrf_nvmc.h>
#include "power_markers.h"

static struct benchmark_metrics metrics;
static bool metrics_active;
static uint32_t icache_hits_start;
static uint32_t icache_misses_start;

/*
 * Clear all metrics and begin recording a benchmark interval.
 */
void benchmark_metrics_reset(void)
{
    metrics = (struct benchmark_metrics){0};
    metrics_active = true;
}

/*
 * Stop accepting updates to the current metrics snapshot.
 */
void benchmark_metrics_stop(void)
{
    metrics_active = false;
}

/*
 * Yield between expensive cryptographic operations.
 */
void benchmark_crypto_reschedule(void)
{
    k_yield();
}

/*
 * Start the available hardware cache counters.
 */
void benchmark_hardware_counters_start(void)
{
#if defined(NVMC_FEATURE_CACHE_PRESENT)
    nrf_nvmc_icache_config_set(NRF_NVMC, NRF_NVMC_ICACHE_ENABLE_WITH_PROFILING);
    icache_hits_start = nrf_nvmc_icache_hit_get(NRF_NVMC);
    icache_misses_start = nrf_nvmc_icache_miss_get(NRF_NVMC);
#endif
}

/*
 * Stop hardware counters and save their deltas.
 */
void benchmark_hardware_counters_stop(void)
{
#if defined(NVMC_FEATURE_CACHE_PRESENT)
    uint32_t hits_end = nrf_nvmc_icache_hit_get(NRF_NVMC);
    uint32_t misses_end = nrf_nvmc_icache_miss_get(NRF_NVMC);

    metrics.instruction_cache_hits = hits_end - icache_hits_start;
    metrics.instruction_cache_misses = misses_end - icache_misses_start;
#endif
}

/*
 * Return a monotonic timestamp for a measured interval.
 */
benchmark_timepoint_t benchmark_metric_start(void)
{
    return k_uptime_ticks();
}

/*
 * Start timing a cryptographic operation and its power marker.
 */
benchmark_timepoint_t benchmark_crypto_metric_start(
    enum benchmark_crypto_operation operation)
{
    benchmark_power_crypto_start(operation);
    return benchmark_metric_start();
}

/*
 * Convert elapsed Zephyr ticks since a timestamp to microseconds.
 */
static uint64_t elapsed_us(benchmark_timepoint_t start)
{
    int64_t elapsed_ticks = k_uptime_ticks() - start;

    return elapsed_ticks > 0 ? k_ticks_to_us_floor64(elapsed_ticks) : 0;
}

/*
 * Finish and accumulate one cryptographic operation interval.
 */
void benchmark_metric_stop(enum benchmark_crypto_operation operation,
                           benchmark_timepoint_t start)
{
    uint64_t elapsed;

    benchmark_power_crypto_stop(operation);
    if (!metrics_active) {
        return;
    }
    elapsed = elapsed_us(start);
    switch (operation) {
    case BENCH_CRYPTO_KEM_KEYGEN:
        metrics.kem_keygen_us += elapsed;
        break;
    case BENCH_CRYPTO_KEM_ENCAPSULATE:
        metrics.kem_encapsulation_us += elapsed;
        break;
    case BENCH_CRYPTO_KEM_DECAPSULATE:
        metrics.kem_decapsulation_us += elapsed;
        break;
    case BENCH_CRYPTO_CERT_VERIFY:
        metrics.certificate_verify_us += elapsed;
        break;
    case BENCH_CRYPTO_CLASSICAL_KEX_KEYGEN:
        metrics.classical_kex_keygen_us += elapsed;
        break;
    case BENCH_CRYPTO_CLASSICAL_KEX_SHARED_SECRET:
        metrics.classical_kex_shared_secret_us += elapsed;
        break;
    case BENCH_CRYPTO_TLS_CERT_VERIFY:
        metrics.tls_certificate_verify_us += elapsed;
        break;
    case BENCH_CRYPTO_MTLS_SIGN:
        metrics.mtls_signature_generate_us += elapsed;
        break;
    }
}

/*
 * Accumulate time spent inside transport callbacks.
 */
void benchmark_communication_stop(benchmark_timepoint_t start)
{
    if (metrics_active) {
        metrics.communication_us += elapsed_us(start);
    }
}

/*
 * Record one successfully transmitted L2CAP SDU.
 */
void benchmark_l2cap_tx(uint32_t bytes)
{
    if (metrics_active) {
        metrics.l2cap_tx_packets++;
        metrics.l2cap_tx_bytes += bytes;
    }
}

/*
 * Record one received L2CAP SDU.
 */
void benchmark_l2cap_rx(uint32_t bytes)
{
    if (metrics_active) {
        metrics.l2cap_rx_packets++;
        metrics.l2cap_rx_bytes += bytes;
    }
}

/*
 * Count an L2CAP transmit retry.
 */
void benchmark_l2cap_tx_retry(void)
{
    if (metrics_active) {
        metrics.l2cap_tx_retries++;
    }
}

/*
 * Accumulate time waiting to transmit over L2CAP.
 */
void benchmark_l2cap_tx_wait_stop(benchmark_timepoint_t start)
{
    if (metrics_active) {
        metrics.l2cap_tx_wait_us += elapsed_us(start);
    }
}

/*
 * Count an L2CAP receive-buffer overflow.
 */
void benchmark_l2cap_rx_overflow(void)
{
    if (metrics_active) {
        metrics.l2cap_rx_overflows++;
    }
}

/*
 * Update the maximum observed L2CAP receive-ring occupancy.
 */
void benchmark_l2cap_rx_ring_usage(uint32_t bytes)
{
    if (metrics_active) {
        metrics.l2cap_rx_ring_peak_bytes =
            MAX(metrics.l2cap_rx_ring_peak_bytes, bytes);
    }
}

/*
 * Save the SignatureScheme observed in server CertificateVerify.
 */
void benchmark_record_server_certificate_verify_scheme(uint16_t scheme)
{
    if (metrics_active) {
        metrics.server_certificate_verify_scheme = scheme;
        metrics.server_certificate_verify_scheme_seen = 1;
    }
}

/*
 * Map a TLS SignatureScheme identifier to its benchmark name.
 */
const char *benchmark_signature_scheme_name(uint16_t scheme)
{
    switch (scheme) {
    case 0x0403: return "ecdsa_secp256r1_sha256";
    case 0x0503: return "ecdsa_secp384r1_sha384";
    case 0x0603: return "ecdsa_secp521r1_sha512";
    case 0x0804: return "rsa_pss_rsae_sha256";
    case 0x0805: return "rsa_pss_rsae_sha384";
    case 0x0806: return "rsa_pss_rsae_sha512";
    case 0x0904: return "mldsa44";
    case 0x0905: return "mldsa65";
    case 0x0906: return "mldsa87";
    default: return "unknown";
    }
}

/*
 * Return the current read-only metrics snapshot.
 */
const struct benchmark_metrics *benchmark_metrics_get(void)
{
    return &metrics;
}
```

## src/benchmark_metrics.h
```c
#pragma once

#include <stdint.h>

enum benchmark_crypto_operation {
    BENCH_CRYPTO_KEM_KEYGEN,
    BENCH_CRYPTO_KEM_ENCAPSULATE,
    BENCH_CRYPTO_KEM_DECAPSULATE,
    BENCH_CRYPTO_CERT_VERIFY,
    BENCH_CRYPTO_CLASSICAL_KEX_KEYGEN,
    BENCH_CRYPTO_CLASSICAL_KEX_SHARED_SECRET,
    BENCH_CRYPTO_TLS_CERT_VERIFY,
    BENCH_CRYPTO_MTLS_SIGN,
};

typedef int64_t benchmark_timepoint_t;

struct benchmark_metrics {
    uint64_t communication_us;
    uint64_t kem_keygen_us;
    uint64_t kem_encapsulation_us;
    uint64_t kem_decapsulation_us;
    uint64_t certificate_verify_us;
    uint64_t classical_kex_keygen_us;
    uint64_t classical_kex_shared_secret_us;
    uint64_t tls_certificate_verify_us;
    uint64_t mtls_signature_generate_us;
    uint32_t l2cap_tx_packets;
    uint32_t l2cap_tx_bytes;
    uint32_t l2cap_rx_packets;
    uint32_t l2cap_rx_bytes;
    uint32_t l2cap_tx_retries;
    uint64_t l2cap_tx_wait_us;
    uint32_t l2cap_rx_overflows;
    uint32_t l2cap_rx_ring_peak_bytes;
    uint32_t instruction_cache_hits;
    uint32_t instruction_cache_misses;
    uint16_t server_certificate_verify_scheme;
    uint8_t server_certificate_verify_scheme_seen;
};

/*
 * Clear all metrics and begin recording a benchmark interval.
 */
void benchmark_metrics_reset(void);
/*
 * Stop accepting updates to the current metrics snapshot.
 */
void benchmark_metrics_stop(void);
/*
 * Yield between expensive cryptographic operations.
 */
void benchmark_crypto_reschedule(void);
/*
 * Start the available hardware cache counters.
 */
void benchmark_hardware_counters_start(void);
/*
 * Stop hardware counters and save their deltas.
 */
void benchmark_hardware_counters_stop(void);
/*
 * Return a monotonic timestamp for a measured interval.
 */
benchmark_timepoint_t benchmark_metric_start(void);
/*
 * Start timing a cryptographic operation and its power marker.
 */
benchmark_timepoint_t benchmark_crypto_metric_start(
    enum benchmark_crypto_operation operation);
/*
 * Finish and accumulate one cryptographic operation interval.
 */
void benchmark_metric_stop(enum benchmark_crypto_operation operation,
                           benchmark_timepoint_t start);
/*
 * Accumulate time spent inside transport callbacks.
 */
void benchmark_communication_stop(benchmark_timepoint_t start);
/*
 * Record one successfully transmitted L2CAP SDU.
 */
void benchmark_l2cap_tx(uint32_t bytes);
/*
 * Record one received L2CAP SDU.
 */
void benchmark_l2cap_rx(uint32_t bytes);
/*
 * Count an L2CAP transmit retry.
 */
void benchmark_l2cap_tx_retry(void);
/*
 * Accumulate time waiting to transmit over L2CAP.
 */
void benchmark_l2cap_tx_wait_stop(benchmark_timepoint_t start);
/*
 * Count an L2CAP receive-buffer overflow.
 */
void benchmark_l2cap_rx_overflow(void);
/*
 * Update the maximum observed L2CAP receive-ring occupancy.
 */
void benchmark_l2cap_rx_ring_usage(uint32_t bytes);
/*
 * Save the SignatureScheme observed in server CertificateVerify.
 */
void benchmark_record_server_certificate_verify_scheme(uint16_t scheme);
/*
 * Map a TLS SignatureScheme identifier to its benchmark name.
 */
const char *benchmark_signature_scheme_name(uint16_t scheme);
/*
 * Return the current read-only metrics snapshot.
 */
const struct benchmark_metrics *benchmark_metrics_get(void);
```

## src/mqtt_transfer.h
```c
#pragma once

#include <zephyr/kernel.h>
#include <wolfssl/ssl.h>

/*
 * Run the bidirectional MQTT payload-transfer benchmark over TLS.
 */
int benchmark_mqtt_transfer_run(WOLFSSL *ssl, struct k_heap *heap,
                                uint32_t heap_capacity);
```

## src/power_markers.c
```c
#include "power_markers.h"

#include <zephyr/drivers/gpio.h>
#include <zephyr/sys/util.h>

#ifdef BENCH_POWER_MARKERS
#define MARKER_TOTAL_PIN 3      /* Arduino A0, SoC P0.03 -> PPK2 D7 */
#define MARKER_HANDSHAKE_PIN 4  /* Arduino A1, SoC P0.04 -> PPK2 D6 */
#define MARKER_KEM_PIN 28       /* Arduino A2, SoC P0.28 -> PPK2 D5 */
#define MARKER_SIGNATURE_PIN 29 /* Arduino A3, SoC P0.29 -> PPK2 D4 */

static const struct device *const gpio0 = DEVICE_DT_GET(DT_NODELABEL(gpio0));
static bool markers_ready;
static unsigned int mlkem_depth;
static unsigned int classical_kex_depth;
static unsigned int signature_depth;

/*
 * Return whether an operation belongs to the ML-KEM phase.
 */
static bool is_mlkem(enum benchmark_crypto_operation operation)
{
    return operation == BENCH_CRYPTO_KEM_KEYGEN ||
           operation == BENCH_CRYPTO_KEM_ENCAPSULATE ||
           operation == BENCH_CRYPTO_KEM_DECAPSULATE;
}

/*
 * Return whether an operation belongs to classical key exchange.
 */
static bool is_classical_kex(enum benchmark_crypto_operation operation)
{
    return operation == BENCH_CRYPTO_CLASSICAL_KEX_KEYGEN ||
           operation == BENCH_CRYPTO_CLASSICAL_KEX_SHARED_SECRET;
}

/*
 * Return whether an operation belongs to certificate processing.
 */
static bool is_signature(enum benchmark_crypto_operation operation)
{
    return operation == BENCH_CRYPTO_CERT_VERIFY ||
           operation == BENCH_CRYPTO_TLS_CERT_VERIFY ||
           operation == BENCH_CRYPTO_MTLS_SIGN;
}

/*
 * Configure all benchmark power-marker GPIO outputs.
 */
void benchmark_power_markers_init(void)
{
    if (!device_is_ready(gpio0)) {
        return;
    }
    gpio_pin_configure(gpio0, MARKER_TOTAL_PIN, GPIO_OUTPUT_INACTIVE);
    gpio_pin_configure(gpio0, MARKER_HANDSHAKE_PIN, GPIO_OUTPUT_INACTIVE);
    gpio_pin_configure(gpio0, MARKER_KEM_PIN, GPIO_OUTPUT_INACTIVE);
    gpio_pin_configure(gpio0, MARKER_SIGNATURE_PIN, GPIO_OUTPUT_INACTIVE);
    markers_ready = true;
}

/*
 * Clear marker GPIOs and nested-operation counters.
 */
void benchmark_power_markers_reset(void)
{
    if (!markers_ready) {
        return;
    }
    mlkem_depth = 0;
    classical_kex_depth = 0;
    signature_depth = 0;
    gpio_port_clear_bits_raw(gpio0, BIT(MARKER_TOTAL_PIN) |
        BIT(MARKER_HANDSHAKE_PIN) | BIT(MARKER_KEM_PIN) |
        BIT(MARKER_SIGNATURE_PIN));
}

/*
 * Set the total-execution power marker.
 */
void benchmark_power_total_set(bool active)
{
    if (markers_ready) {
        gpio_pin_set_raw(gpio0, MARKER_TOTAL_PIN, active);
    }
}

/*
 * Set the TLS-handshake power marker.
 */
void benchmark_power_handshake_set(bool active)
{
    if (markers_ready) {
        gpio_pin_set_raw(gpio0, MARKER_HANDSHAKE_PIN, active);
    }
}

/*
 * Enter a marked cryptographic operation region.
 */
void benchmark_power_crypto_start(enum benchmark_crypto_operation operation)
{
    if (!markers_ready) {
        return;
    }
    if (is_mlkem(operation) && mlkem_depth++ == 0) {
        gpio_pin_set_raw(gpio0, MARKER_KEM_PIN, 1);
    }
    /* D5 marks every KEX operation. D5+D4 identifies the classical
     * ECDHE/X25519 component without requiring a fifth PPK2 wire. */
    if (is_classical_kex(operation) && classical_kex_depth++ == 0) {
        gpio_pin_set_raw(gpio0, MARKER_KEM_PIN, 1);
        gpio_pin_set_raw(gpio0, MARKER_SIGNATURE_PIN, 1);
    }
    if (is_signature(operation) && signature_depth++ == 0) {
        gpio_pin_set_raw(gpio0, MARKER_SIGNATURE_PIN, 1);
    }
}

/*
 * Leave a marked cryptographic operation region.
 */
void benchmark_power_crypto_stop(enum benchmark_crypto_operation operation)
{
    if (!markers_ready) {
        return;
    }
    if (is_mlkem(operation) && mlkem_depth > 0 && --mlkem_depth == 0 &&
        classical_kex_depth == 0) {
        gpio_pin_set_raw(gpio0, MARKER_KEM_PIN, 0);
    }
    if (is_classical_kex(operation) && classical_kex_depth > 0 &&
        --classical_kex_depth == 0) {
        if (mlkem_depth == 0) {
            gpio_pin_set_raw(gpio0, MARKER_KEM_PIN, 0);
        }
        if (signature_depth == 0) {
            gpio_pin_set_raw(gpio0, MARKER_SIGNATURE_PIN, 0);
        }
    }
    if (is_signature(operation) && signature_depth > 0 && --signature_depth == 0) {
        if (classical_kex_depth == 0) {
            gpio_pin_set_raw(gpio0, MARKER_SIGNATURE_PIN, 0);
        }
    }
}
#else
/*
 * Provide a no-op marker initializer when power profiling is disabled.
 */
void benchmark_power_markers_init(void) {}
/*
 * Provide a no-op marker reset when power profiling is disabled.
 */
void benchmark_power_markers_reset(void) {}
/*
 * Ignore total-execution marker updates when profiling is disabled.
 */
void benchmark_power_total_set(bool active) { ARG_UNUSED(active); }
/*
 * Ignore handshake marker updates when profiling is disabled.
 */
void benchmark_power_handshake_set(bool active) { ARG_UNUSED(active); }
/*
 * Ignore cryptographic marker starts when profiling is disabled.
 */
void benchmark_power_crypto_start(enum benchmark_crypto_operation operation) { ARG_UNUSED(operation); }
/*
 * Ignore cryptographic marker stops when profiling is disabled.
 */
void benchmark_power_crypto_stop(enum benchmark_crypto_operation operation) { ARG_UNUSED(operation); }
#endif
```

## src/power_markers.h
```c
#pragma once

#include <stdbool.h>
#include "benchmark_metrics.h"

/*
 * Configure all benchmark power-marker GPIO outputs.
 */
void benchmark_power_markers_init(void);
/*
 * Clear marker GPIOs and nested-operation counters.
 */
void benchmark_power_markers_reset(void);
/*
 * Set the total-execution power marker.
 */
void benchmark_power_total_set(bool active);
/*
 * Set the TLS-handshake power marker.
 */
void benchmark_power_handshake_set(bool active);
/*
 * Enter a marked cryptographic operation region.
 */
void benchmark_power_crypto_start(enum benchmark_crypto_operation operation);
/*
 * Leave a marked cryptographic operation region.
 */
void benchmark_power_crypto_stop(enum benchmark_crypto_operation operation);
```

## src/pqm4_mlkem_backend.h
```c
#pragma once

/*
 * Register the pqm4 ML-KEM callback backend with wolfSSL.
 */
int pqm4_mlkem_backend_init(void);
/*
 * Return the wolfSSL device identifier assigned to pqm4 ML-KEM.
 */
int pqm4_mlkem_backend_dev_id(void);
```

## src/pqm4_namespace.h
```c
#ifndef PQM4_PREFIX
#error "PQM4_PREFIX must identify the ML-KEM parameter set"
#endif

#define PQM4_JOIN_INNER(a, b) a##b
#define PQM4_JOIN(a, b) PQM4_JOIN_INNER(a, b)
#define PQM4_NS(symbol) PQM4_JOIN(PQM4_PREFIX, symbol)

#define crypto_kem_keypair PQM4_NS(crypto_kem_keypair)
#define crypto_kem_enc PQM4_NS(crypto_kem_enc)
#define crypto_kem_dec PQM4_NS(crypto_kem_dec)
#define verify PQM4_NS(verify)
#define cmov PQM4_NS(cmov)
#define cbd PQM4_NS(cbd)
#define kyber_shake128_absorb PQM4_NS(kyber_shake128_absorb)
#define kyber_shake256_prf PQM4_NS(kyber_shake256_prf)
#define kyber_shake256_rkprf PQM4_NS(kyber_shake256_rkprf)
#define indcpa_keypair_derand PQM4_NS(indcpa_keypair_derand)
#define indcpa_enc PQM4_NS(indcpa_enc)
#define indcpa_enc_cmp PQM4_NS(indcpa_enc_cmp)
#define indcpa_dec PQM4_NS(indcpa_dec)
#define matacc PQM4_NS(matacc)
#define ntt PQM4_NS(ntt)
#define invntt PQM4_NS(invntt)
#define poly_compress PQM4_NS(poly_compress)
#define poly_decompress PQM4_NS(poly_decompress)
#define poly_packcompress PQM4_NS(poly_packcompress)
#define poly_unpackdecompress PQM4_NS(poly_unpackdecompress)
#define cmp_poly_compress PQM4_NS(cmp_poly_compress)
#define cmp_poly_packcompress PQM4_NS(cmp_poly_packcompress)
#define poly_tobytes PQM4_NS(poly_tobytes)
#define poly_frombytes PQM4_NS(poly_frombytes)
#define poly_frombytes_mul PQM4_NS(poly_frombytes_mul)
#define poly_frombytes_mul_acc PQM4_NS(poly_frombytes_mul_acc)
#define poly_noise PQM4_NS(poly_noise)
#define poly_ntt PQM4_NS(poly_ntt)
#define poly_invntt PQM4_NS(poly_invntt)
#define poly_basemul PQM4_NS(poly_basemul)
#define poly_basemul_acc PQM4_NS(poly_basemul_acc)
#define poly_fromplant PQM4_NS(poly_fromplant)
#define poly_reduce PQM4_NS(poly_reduce)
#define poly_add PQM4_NS(poly_add)
#define poly_sub PQM4_NS(poly_sub)
#define poly_frommsg PQM4_NS(poly_frommsg)
#define poly_tomsg PQM4_NS(poly_tomsg)
#define poly_zeroize PQM4_NS(poly_zeroize)
#define polyvec_compress PQM4_NS(polyvec_compress)
#define polyvec_decompress PQM4_NS(polyvec_decompress)
#define polyvec_tobytes PQM4_NS(polyvec_tobytes)
#define polyvec_frombytes PQM4_NS(polyvec_frombytes)
#define polyvec_ntt PQM4_NS(polyvec_ntt)
#define polyvec_invntt PQM4_NS(polyvec_invntt)
#define polyvec_reduce PQM4_NS(polyvec_reduce)
#define polyvec_add PQM4_NS(polyvec_add)
#define asm_barrett_reduce PQM4_NS(asm_barrett_reduce)
#define asm_fromplant PQM4_NS(asm_fromplant)
#define basemul_asm PQM4_NS(basemul_asm)
#define basemul_asm_acc PQM4_NS(basemul_asm_acc)
#define cmov_int16 PQM4_NS(cmov_int16)
#define frombytes_mul_asm PQM4_NS(frombytes_mul_asm)
#define frombytes_mul_asm_acc PQM4_NS(frombytes_mul_asm_acc)
#define invntt_fast PQM4_NS(invntt_fast)
#define matacc_asm PQM4_NS(matacc_asm)
#define matacc_asm_acc PQM4_NS(matacc_asm_acc)
#define ntt_fast PQM4_NS(ntt_fast)
#define pointwise_add PQM4_NS(pointwise_add)
#define pointwise_sub PQM4_NS(pointwise_sub)
#define zetas PQM4_NS(zetas)
#define zetas_asm PQM4_NS(zetas_asm)
#define zetas_inv_CT_asm PQM4_NS(zetas_inv_CT_asm)
```
