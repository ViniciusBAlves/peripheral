## CMakeLists.txt
```
cmake_minimum_required(VERSION 3.20.0)

find_package(Zephyr REQUIRED HINTS $ENV{ZEPHYR_BASE})
project(peripheral)

# SLH-DSA X.509 support landed after wolfSSL 5.9.1. Pin the reviewed upstream
# revision so pristine builds are reproducible while avoiding changes to NCS.
include(FetchContent)
if(POLICY CMP0169)
    cmake_policy(SET CMP0169 OLD)
endif()
set(FETCHCONTENT_BASE_DIR "${CMAKE_CURRENT_SOURCE_DIR}/third_party/.cache")
FetchContent_Declare(wolfssl_upstream
    URL https://github.com/wolfSSL/wolfssl/archive/dd6da70d395a0cb26446326f329678fe3bfb212c.tar.gz
    URL_HASH SHA256=087ac84de980da83e7f1a3014dd241358f64d9a330dec74c6eb1404495ad2cf7
    DOWNLOAD_EXTRACT_TIMESTAMP FALSE
)
FetchContent_GetProperties(wolfssl_upstream)
if(NOT wolfssl_upstream_POPULATED)
    FetchContent_Populate(wolfssl_upstream)
endif()
set(WOLFSSL_ROOT_DIR "${wolfssl_upstream_SOURCE_DIR}")

# 1. Bind EVERYTHING directly to the 'app' target
target_sources(app PRIVATE src/main.c
    # --- Post Quantum Math ---
    ${WOLFSSL_ROOT_DIR}/wolfcrypt/src/wc_mlkem.c
    ${WOLFSSL_ROOT_DIR}/wolfcrypt/src/wc_mlkem_poly.c
    ${WOLFSSL_ROOT_DIR}/wolfcrypt/src/wc_mldsa.c
    ${WOLFSSL_ROOT_DIR}/wolfcrypt/src/wc_slhdsa.c
    
    # --- Core Cryptography & Hashes ---
    ${WOLFSSL_ROOT_DIR}/wolfcrypt/src/random.c
    ${WOLFSSL_ROOT_DIR}/wolfcrypt/src/hash.c
    ${WOLFSSL_ROOT_DIR}/wolfcrypt/src/sha.c
    ${WOLFSSL_ROOT_DIR}/wolfcrypt/src/sha256.c
    ${WOLFSSL_ROOT_DIR}/wolfcrypt/src/sha512.c
    ${WOLFSSL_ROOT_DIR}/wolfcrypt/src/sha3.c
    ${WOLFSSL_ROOT_DIR}/wolfcrypt/src/hmac.c
    ${WOLFSSL_ROOT_DIR}/wolfcrypt/src/aes.c
    ${WOLFSSL_ROOT_DIR}/wolfcrypt/src/ecc.c
    ${WOLFSSL_ROOT_DIR}/wolfcrypt/src/curve25519.c
    ${WOLFSSL_ROOT_DIR}/wolfcrypt/src/rsa.c
    ${WOLFSSL_ROOT_DIR}/wolfcrypt/src/kdf.c
    ${WOLFSSL_ROOT_DIR}/wolfcrypt/src/ed25519.c
    
    # --- Legacy Support ---
    ${WOLFSSL_ROOT_DIR}/wolfcrypt/src/md5.c
    ${WOLFSSL_ROOT_DIR}/wolfcrypt/src/des3.c
    ${WOLFSSL_ROOT_DIR}/wolfcrypt/src/dh.c
    ${WOLFSSL_ROOT_DIR}/wolfcrypt/src/dsa.c

    # --- Math Helpers & Decoding ---
    ${WOLFSSL_ROOT_DIR}/wolfcrypt/src/coding.c
    ${WOLFSSL_ROOT_DIR}/wolfcrypt/src/misc.c
    ${WOLFSSL_ROOT_DIR}/wolfcrypt/src/wolfmath.c
    ${WOLFSSL_ROOT_DIR}/wolfcrypt/src/fe_operations.c
    ${WOLFSSL_ROOT_DIR}/wolfcrypt/src/ge_operations.c
    
    # --- Memory & System ---
    ${WOLFSSL_ROOT_DIR}/wolfcrypt/src/tfm.c
    ${WOLFSSL_ROOT_DIR}/wolfcrypt/src/memory.c
    ${WOLFSSL_ROOT_DIR}/wolfcrypt/src/asn.c
    ${WOLFSSL_ROOT_DIR}/wolfcrypt/src/wc_port.c
    ${WOLFSSL_ROOT_DIR}/wolfcrypt/src/logging.c
    
    # --- TLS Engine ---
    ${WOLFSSL_ROOT_DIR}/src/ssl.c
    ${WOLFSSL_ROOT_DIR}/src/tls.c
    ${WOLFSSL_ROOT_DIR}/src/tls13.c
    ${WOLFSSL_ROOT_DIR}/src/keys.c
    ${WOLFSSL_ROOT_DIR}/src/internal.c
    ${WOLFSSL_ROOT_DIR}/src/wolfio.c
)

target_include_directories(app PRIVATE 
    ${CMAKE_CURRENT_SOURCE_DIR}
    ${WOLFSSL_ROOT_DIR}
    ${WOLFSSL_ROOT_DIR}/wolfssl
)

# CRITICAL FIX: Target-specific definitions and includes (NOT Global)
target_compile_definitions(app PRIVATE WOLFSSL_USER_SETTINGS)
target_compile_options(app PRIVATE -include ${CMAKE_CURRENT_SOURCE_DIR}/user_settings.h)
```

## prj.conf
```kconfig
# --- Basic Bluetooth ---
CONFIG_BT=y
CONFIG_BT_PERIPHERAL=y
CONFIG_BT_DEVICE_NAME="Zephyr"

# --- L2CAP ---
CONFIG_BT_L2CAP_DYNAMIC_CHANNEL=y

# --- Settings (Required for L2CAP Server) ---
CONFIG_SETTINGS=y
CONFIG_BT_SETTINGS=y
CONFIG_BT_PERIPHERAL_PREF_MIN_INT=12
CONFIG_BT_PERIPHERAL_PREF_MAX_INT=12
CONFIG_BT_PERIPHERAL_PREF_LATENCY=0
CONFIG_BT_PERIPHERAL_PREF_TIMEOUT=400
CONFIG_NVS=y
CONFIG_FLASH=y
CONFIG_FLASH_MAP=y

CONFIG_BT_SMP=y
# CONFIG_BT_FIXED_PASSKEY is not set

# The Pi bridge disables onboard Wi-Fi during BLE runs, which removes the
# coexistence problem that made the link unstable.  Keep the BLE link fast.
CONFIG_BT_LL_SOFTDEVICE=y
CONFIG_BT_AUTO_DATA_LEN_UPDATE=y
CONFIG_BT_DATA_LEN_UPDATE=y
CONFIG_BT_PHY_UPDATE=y
CONFIG_BT_CTLR_TX_PWR_PLUS_8=y

# --- Hardware RNG (Required for wolfSSL PQC) ---
CONFIG_ENTROPY_GENERATOR=y
CONFIG_TEST_RANDOM_GENERATOR=y

# --- Memory & System ---
CONFIG_WOLFSSL_BUILTIN=y
CONFIG_HEAP_MEM_POOL_SIZE=0
CONFIG_COMMON_LIBC_MALLOC_ARENA_SIZE=12288
CONFIG_MAIN_STACK_SIZE=8192
CONFIG_SYSTEM_WORKQUEUE_STACK_SIZE=3072
CONFIG_SYS_HEAP_RUNTIME_STATS=y
CONFIG_RING_BUFFER_LARGE=y

# --- Runtime benchmark telemetry ---
# Thread Analyzer gives per-thread stack usage and runtime CPU utilization on
# demand.  The benchmark calls it once after each TLS handshake so the serial
# log has a clean snapshot without a periodic analyzer thread adding noise.
CONFIG_THREAD_ANALYZER=y
CONFIG_THREAD_ANALYZER_USE_PRINTK=y
CONFIG_THREAD_NAME=y
# Keep Bluetooth interrupts unlocked while the analyzer walks thread stacks.
CONFIG_THREAD_ANALYZER_RUN_UNLOCKED=y

# --- Bluetooth Buffers ---
CONFIG_BT_BUF_ACL_TX_SIZE=251
CONFIG_BT_BUF_ACL_RX_SIZE=251
CONFIG_BT_BUF_ACL_TX_COUNT=2
CONFIG_BT_BUF_EVT_RX_COUNT=6
CONFIG_BT_L2CAP_TX_MTU=672

# --- Required Dependencies ---
CONFIG_GPIO=y
CONFIG_MBEDTLS_SHA1_C=y
CONFIG_PSA_WANT_ALG_SHA_1=y

CONFIG_WOLFSSL_SETTINGS_FILE="user_settings.h"
```

## src/client_cert.h
```c
#ifndef CLIENT_CERT_H
#define CLIENT_CERT_H

const char client_pem[] =
"-----BEGIN CERTIFICATE-----n"
"MIIBcTCCARagAwIBAgIUSi336R3BRG7LebXnuXh0fVjNVDEwCgYIKoZIzj0EAwIw\n"
"EzERMA8GA1UEAwwITXlSb290Q0EwHhcNMjYwNjE1MjA0NDE4WhcNMjcwNjE1MjA0\n"
"NDE4WjAZMRcwFQYDVQQDDA5ucmY1MzQwX2NsaWVudDBZMBMGByqGSM49AgEGCCqG\n"
"SM49AwEHA0IABNG9Aab/LtLnV1fkPqy11lmehlWoOOfsbJ66ZK9/y8x1ueN6gwlG\n"
"eKHQJoE7Jkpux000VNo36RRXuh85vIzvdsSjQjBAMB0GA1UdDgQWBBRjQI4joTWl\n"
"K6lVN/CNjvI/0fZoUTAfBgNVHSMEGDAWgBQ8i67UCrvLa0/RGRBjKpiaGfa4cDAK\n"
"BggqhkjOPQQDAgNJADBGAiEAohCwEQEi6DpkR+oFvQXeDSvUq8EagUlZKocbrIK3\n"
"M+ACIQCv6CZb8YJ6MGQeL90XJztiuLhcOWCcaTC1nyArjDtPgQ==\n"
"-----END CERTIFICATE-----\n";
#endif
```

## src/client_key.h
```c
#ifndef CLIENT_KEY_H
#define CLIENT_KEY_H

const char client_key_pem[] =
"-----BEGIN EC PRIVATE KEY-----\n"
"MHcCAQEEICt5/jLn6v1ItOt379be/dDnLoDUBL2RLSlXXH99TTCEoAoGCCqGSM49\n"
"AwEHoUQDQgAE0b0Bpv8u0udXV+Q+rLXWWZ6GVag45+xsnrpkr3/LzHW543qDCUZ4\n"
"odAmgTsmSm7HTTRU2jfpFFe6Hzm8jO92xA==\n"
"-----END EC PRIVATE KEY-----\n";
#endif
```
